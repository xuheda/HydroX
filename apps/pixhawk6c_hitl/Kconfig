## apps/pixhawk6c_hitl/Kconfig
```kconfig
config HYDROX_PIXHAWK6C_HITL
	bool "HydroX Pixhawk 6C HITL application"
	default n
	help
		Build the HydroX HITL-only application. Simulated sensor data enters
		through the OceanX MAVLink HIL device and normalized actuator commands return
		to the simulator. Physical actuator outputs remain disabled.

if HYDROX_PIXHAWK6C_HITL

config HYDROX_HITL_PRIORITY
	int "HydroX supervisor task priority"
	default 180
	range 1 255

config HYDROX_HITL_STACKSIZE
	int "HydroX supervisor task stack size"
	default 8192

endif
```

## boards/fmu_v6c/configs/hydrox_hitl/defconfig
```kconfig
# HydroX HITL-only FMUv6C configuration (Pixhawk 6C / 6C Mini).
# Physical PWM, DShot, CAN actuator and PX4IO drivers are intentionally absent.
CONFIG_ARCH="arm"
CONFIG_ARCH_BOARD_CUSTOM=y
CONFIG_ARCH_BOARD_CUSTOM_DIR="../../boards/fmu_v6c"
CONFIG_ARCH_BOARD_CUSTOM_DIR_RELPATH=y
CONFIG_ARCH_BOARD_CUSTOM_NAME="fmu-v6c"
CONFIG_ARCH_CHIP="stm32h7"
CONFIG_ARCH_CHIP_STM32=y
CONFIG_ARCH_CHIP_STM32H743VI=y
CONFIG_ARCH_CHIP_STM32H7=y
CONFIG_ARCH_CHIP_STM32H7_CORTEXM7=y
CONFIG_ARCH_TOOLCHAIN_GNU_EABI=y
CONFIG_ARCH_STACKDUMP=y
CONFIG_ARMV7M_BASEPRI_WAR=y
CONFIG_ARMV7M_DCACHE=y
CONFIG_ARMV7M_DTCM=y
CONFIG_ARMV7M_ICACHE=y
CONFIG_ARMV7M_MEMCPY=y
CONFIG_ARMV7M_USEBASEPRI=y
CONFIG_BOARD_LATE_INITIALIZE=y
CONFIG_BOARD_LOOPSPERMSEC=95751
CONFIG_BOARD_RESET_ON_ASSERT=2
CONFIG_BOARDCTL_RESET=y
CONFIG_BUILTIN=y
CONFIG_DEBUG_SYMBOLS=y
CONFIG_DEFAULT_TASK_STACKSIZE=4096
CONFIG_EXPERIMENTAL=y
CONFIG_FS_PROCFS=y
CONFIG_HAVE_CXX=y
CONFIG_HAVE_CXXINITIALIZE=y
CONFIG_INIT_ENTRYPOINT="hydrox_hitl_main"
CONFIG_INIT_STACKSIZE=16384
CONFIG_LIBCXXTOOLCHAIN=y
CONFIG_LIBC_FLOATINGPOINT=y
CONFIG_LIBC_LONG_LONG=y
CONFIG_MM_REGIONS=4
CONFIG_NAME_MAX=48
CONFIG_NSH_BUILTIN_APPS=y
CONFIG_PREALLOC_TIMERS=16
CONFIG_PRIORITY_INHERITANCE=y
CONFIG_PTHREAD_MUTEX_ROBUST=y
CONFIG_PTHREAD_MUTEX_TYPES=y
CONFIG_RAM_SIZE=245760
CONFIG_RAM_START=0x20010000
CONFIG_RAW_BINARY=y
CONFIG_RR_INTERVAL=10
CONFIG_SCHED_HPWORK=y
CONFIG_SCHED_LPWORK=y
CONFIG_SCHED_WAITPID=y
CONFIG_SERIAL_IFLOWCONTROL=y
CONFIG_SERIAL_IFLOWCONTROL_WATERMARKS=y
CONFIG_SERIAL_TERMIOS=y
CONFIG_STACK_COLORATION=y
CONFIG_START_DAY=1
CONFIG_START_MONTH=1
CONFIG_START_YEAR=2026
CONFIG_STDIO_BUFFER_SIZE=256
CONFIG_TASK_NAME_SIZE=24
CONFIG_USEC_PER_TICK=1000
CONFIG_WATCHDOG=y

# USB-C diagnostics (/dev/ttyACM0); not part of the HIL data path.
CONFIG_CDCACM=y
CONFIG_CDCACM_PRODUCTID=0x0038
CONFIG_CDCACM_PRODUCTSTR="HydroX FMUv6C HITL"
CONFIG_CDCACM_RXBUFSIZE=1024
CONFIG_CDCACM_TXBUFSIZE=2048
CONFIG_CDCACM_VENDORID=0x3185
CONFIG_CDCACM_VENDORSTR="OceanX"
CONFIG_STM32_OTGFS=y
CONFIG_USBDEV=y
CONFIG_USBDEV_BUSPOWERED=y
CONFIG_USBDEV_MAXPOWER=500

# Keep the PX4 FMUv6C serial enumeration. HydroX opens only ttyS5 and ttyS3.
CONFIG_STM32_USART1=y
CONFIG_STM32_USART2=y
CONFIG_STM32_USART3=y
CONFIG_STM32_UART5=y
CONFIG_STM32_USART6=y
CONFIG_STM32_UART7=y
CONFIG_STM32_UART8=y
CONFIG_USART1_BAUD=57600
CONFIG_USART2_BAUD=57600
CONFIG_USART3_BAUD=115200
CONFIG_USART3_RXBUFSIZE=512
CONFIG_USART3_SERIAL_CONSOLE=y
CONFIG_USART3_TXBUFSIZE=1024
CONFIG_USART6_BAUD=1500000
CONFIG_UART8_BAUD=57600

# TELEM2 / RK3588 command link.
CONFIG_UART5_BAUD=921600
CONFIG_UART5_IFLOWCONTROL=y
CONFIG_UART5_OFLOWCONTROL=y
CONFIG_UART5_RXBUFSIZE=4096
CONFIG_UART5_RXDMA=y
CONFIG_UART5_TXBUFSIZE=4096
CONFIG_UART5_TXDMA=y

# TELEM1 / UE Router HIL link.
CONFIG_UART7_BAUD=921600
CONFIG_UART7_IFLOWCONTROL=y
CONFIG_UART7_OFLOWCONTROL=y
CONFIG_UART7_RXBUFSIZE=4096
CONFIG_UART7_RXDMA=y
CONFIG_UART7_TXBUFSIZE=4096
CONFIG_UART7_TXDMA=y

CONFIG_STM32_DMA1=y
CONFIG_STM32_DMA2=y
CONFIG_STM32_IWDG=y

# HydroX built-in application.
CONFIG_HYDROX_HITL=y
CONFIG_HYDROX_HITL_PRIORITY=180
CONFIG_HYDROX_HITL_STACKSIZE=16384
```

## nuttx_apps/external/Kconfig
```kconfig
menu "OceanX / HydroX applications"

config HYDROX_HITL
	bool "HydroX FMUv6C HITL firmware"
	default n
	help
		Build the HITL-only HydroX supervisor for the common Holybro FMUv6C
		firmware target used by Pixhawk 6C and Pixhawk 6C Mini. Physical PWM,
		DShot, CAN actuator and PX4IO output drivers are intentionally absent.

if HYDROX_HITL

config HYDROX_HITL_PRIORITY
	int "HydroX supervisor task priority"
	default 180
	range 1 255

config HYDROX_HITL_STACKSIZE
	int "HydroX supervisor task stack size"
	default 16384
	range 8192 65536

endif

endmenu
```
